/**
 * @cliArgs --board "/ti/boards/CC1352R1_LAUNCHXL" --product "simplelink_cc13x2_26x2_sdk@4.30.00.54"
 * @versions {"data":"2020090214","timestamp":"2020090214","tool":"1.6.0+1543","templates":"2020090214"}
 */

/**
 * Import the modules used in this configuration.
 */
const CCFG      = scripting.addModule("/ti/devices/CCFG");
const custom    = scripting.addModule("/ti/devices/radioconfig/custom");
const GPIO      = scripting.addModule("/ti/drivers/GPIO", {}, false);
const GPIO1     = GPIO.addInstance();
const GPIO2     = GPIO.addInstance();
const GPIO3     = GPIO.addInstance();
const GPIO4     = GPIO.addInstance();
const GPIO5     = GPIO.addInstance();
const I2C       = scripting.addModule("/ti/drivers/I2C", {}, false);
const I2C1      = I2C.addInstance();
const NVS       = scripting.addModule("/ti/drivers/NVS", {}, false);
const NVS1      = NVS.addInstance();
const Power     = scripting.addModule("/ti/drivers/Power");
const SPI       = scripting.addModule("/ti/drivers/SPI", {}, false);
const SPI1      = SPI.addInstance();
const TRNG      = scripting.addModule("/ti/drivers/TRNG", {}, false);
const TRNG1     = TRNG.addInstance();
const UART      = scripting.addModule("/ti/drivers/UART", {}, false);
const UART1     = UART.addInstance();
const Watchdog  = scripting.addModule("/ti/drivers/Watchdog", {}, false);
const Watchdog1 = Watchdog.addInstance();

/**
 * Write custom configuration values to the imported modules.
 */
CCFG.enableBootloader         = true;
CCFG.enableBootloaderBackdoor = true;
CCFG.dioBootloaderBackdoor    = 15;
CCFG.levelBootloaderBackdoor  = "Active low";
CCFG.forceVddr                = true;
CCFG.ccfgTemplate.$name       = "ti_devices_CCFGTemplate0";

custom.prop8                                                      = ["custom868"];
custom.radioConfigcustom868.$name                                 = "ti_devices_radioconfig_settings_prop0";
custom.radioConfigcustom868.phyType868                            = "2gfsk50kbps154g";
custom.radioConfigcustom868.codeExportConfig.$name                = "ti_devices_radioconfig_code_export_param0";
custom.radioConfigcustom868.codeExportConfig.symGenMethod         = "Custom";
custom.radioConfigcustom868.codeExportConfig.cmdPropRadioDivSetup = "rf_cmd_prop_radio_div_setup";
custom.radioConfigcustom868.codeExportConfig.cmdFs                = "rf_cmd_prop_fs";
custom.radioConfigcustom868.codeExportConfig.cmdPropTxAdv         = "rf_cmd_prop_tx_adv";
custom.radioConfigcustom868.codeExportConfig.cmdPropRxAdv         = "rf_cmd_prop_rx_adv";
custom.radioConfigcustom868.codeExportConfig.rfMode               = "rf_prop_mode";
custom.radioConfigcustom868.codeExportConfig.overrides            = "rf_prop_overrides";

GPIO1.$hardware         = system.deviceData.board.components.LED_RED;
GPIO1.$name             = "CONFIG_GPIO_R";
GPIO1.pinInstance.$name = "CONFIG_PIN_2";

GPIO2.$hardware         = system.deviceData.board.components.LED_GREEN;
GPIO2.$name             = "CONFIG_GPIO_G";
GPIO2.pinInstance.$name = "CONFIG_PIN_3";

GPIO3.$hardware         = system.deviceData.board.components["BTN-1"];
GPIO3.$name             = "CONFIG_GPIO_BTN_L";
GPIO3.pinInstance.$name = "CONFIG_PIN_4";

GPIO4.$hardware         = system.deviceData.board.components["BTN-2"];
GPIO4.$name             = "CONFIG_GPIO_BTN_R";
GPIO4.pinInstance.$name = "CONFIG_PIN_5";

GPIO5.$name             = "CONFIG_GPIO_STA";
GPIO5.mode              = "Output";
GPIO5.gpioPin.$assign   = "boosterpack.37";
GPIO5.pinInstance.$name = "CONFIG_PIN_11";

I2C1.$name                = "CONFIG_I2C_0";
I2C1.i2c.sdaPin.$assign   = "boosterpack.9";
I2C1.i2c.sclPin.$assign   = "boosterpack.10";
I2C1.sdaPinInstance.$name = "CONFIG_PIN_12";
I2C1.clkPinInstance.$name = "CONFIG_PIN_13";

NVS1.$name               = "CONFIG_NVS";
NVS1.internalFlash.$name = "ti_drivers_nvs_NVSCC26XX0";

SPI1.$name                 = "CONFIG_SPI_0";
SPI1.$hardware             = system.deviceData.board.components.LP_SPI;
SPI1.sclkPinInstance.$name = "CONFIG_PIN_6";
SPI1.misoPinInstance.$name = "CONFIG_PIN_7";
SPI1.mosiPinInstance.$name = "CONFIG_PIN_8";

TRNG1.$name = "CONFIG_TRNG_0";

UART1.$name               = "CONFIG_UART_0";
UART1.txPinInstance.$name = "CONFIG_PIN_0";
UART1.rxPinInstance.$name = "CONFIG_PIN_1";
UART1.uart.txPin.$assign  = "boosterpack.31";
UART1.uart.rxPin.$assign  = "boosterpack.36";

Watchdog1.$name  = "CONFIG_WATCHDOG_0";
Watchdog1.period = 15000;

/**
 * Pinmux solution for unlocked pins/peripherals. This ensures that minor changes to the automatic solver in a future
 * version of the tool will not impact the pinmux you originally saw.  These lines can be completely deleted in order to
 * re-solve from scratch.
 */
GPIO1.gpioPin.$suggestSolution         = "boosterpack.39";
GPIO2.gpioPin.$suggestSolution         = "boosterpack.40";
GPIO3.gpioPin.$suggestSolution         = "boosterpack.13";
GPIO4.gpioPin.$suggestSolution         = "boosterpack.12";
I2C1.i2c.$suggestSolution              = "I2C0";
SPI1.spi.$suggestSolution              = "SSI0";
SPI1.spi.sclkPin.$suggestSolution      = "boosterpack.7";
SPI1.spi.misoPin.$suggestSolution      = "boosterpack.14";
SPI1.spi.mosiPin.$suggestSolution      = "boosterpack.15";
SPI1.spi.dmaRxChannel.$suggestSolution = "DMA_CH3";
SPI1.spi.dmaTxChannel.$suggestSolution = "DMA_CH4";
UART1.uart.$suggestSolution            = "UART0";
Watchdog1.watchdog.$suggestSolution    = "WDT0";
